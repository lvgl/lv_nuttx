## my_lvgl_apps/my_lvgl_app/Kconfig
```kconfig
#
# For a description of the syntax of this configuration file,
# see the file kconfig-language.txt in the NuttX tools repository.
#

config MY_LVGL_APPS_MY_LVGL_APP
        tristate "My LVGL App"
        default n
        ---help---
                Enable the My LVGL App

if MY_LVGL_APPS_MY_LVGL_APP

config MY_LVGL_APPS_MY_LVGL_APP_PROGNAME
        string "Program name"
        default "my_lvgl_app"
        ---help---
                This is the name of the program that will be used when the NSH ELF
                program is installed.

config MY_LVGL_APPS_MY_LVGL_APP_PRIORITY
        int "My LVGL App task priority"
        default 100

config MY_LVGL_APPS_MY_LVGL_APP_STACKSIZE
        int "My LVGL App stack size"
        default 16384

endif
```
